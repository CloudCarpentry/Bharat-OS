/* Generated Bharat-OS Linker Script for ARM32 MMU-Lite
 * Target Board: {{ board.board }}
 * SoC: {{ board.soc }} ({{ board.architecture }} / {{ board.cpu }})
 */

OUTPUT_FORMAT("elf32-littlearm")
OUTPUT_ARCH(arm)
ENTRY({{ board.boot.entry }})

SECTIONS
{
    /* Load base: QEMU virt ARM32 RAM base + offset */
    . = {{ board.memory.ram.origin }} + 0x10000;

    .text ALIGN(4096) :
    {
        KEEP(*(.text.boot))
        KEEP(*(.text.init))
        *(.text)
        *(.text.*)
        *(.fixup)
    }

    .rodata ALIGN(4096) :
    {
        *(.rodata)
        *(.rodata.*)

        . = ALIGN(8);
        __ex_table_start = .;
        KEEP(*(__ex_table))
        __ex_table_end = .;

        . = ALIGN(8);
        __start_bharat_services = .;
        KEEP(*(bharat_services))
        __stop_bharat_services = .;

        . = ALIGN(8);
        __kern_tests_start = .;
        KEEP(*(.kern_tests))
        __kern_tests_end = .;

        . = ALIGN(8);
        __subsys_tests_start = .;
        KEEP(*(.subsys_tests))
        __subsys_tests_end = .;
    }

    .data ALIGN(4096) :
    {
        *(.data)
        *(.data.*)
    }

    .bss ALIGN(4096) :
    {
        bss_start = .;
        __bss_start = .;
        *(.bss)
        *(.bss.*)
        *(COMMON)
        bss_end = .;
        __bss_end = .;
    }

    .pstore ALIGN(4096) (NOLOAD) :
    {
        _pstore_start = .;
        *(.pstore)
        . = . + 4096;
        _pstore_end = .;
    }

    . = ALIGN(4096);
    kernel_end = .;
    _end = .;

    /DISCARD/ :
    {
        *(.comment)
        *(.eh_frame)
    }
}
